## EkxEsp/sdkconfig.defaults
```kconfig
CONFIG_IDF_TARGET="esp32"
CONFIG_IDF_TARGET_ESP32=y
CONFIG_ESPTOOLPY_FLASHSIZE_8MB=y
CONFIG_ESPTOOLPY_BAUD_921600B=y
CONFIG_COMPILER_CXX_RTTI=y
CONFIG_COMPILER_CXX_EXCEPTIONS=y
CONFIG_PARTITION_TABLE_CUSTOM=y
CONFIG_ESP_TASK_WDT_PANIC=y
#CONFIG_LWIP_IP4_REASSEMBLY=y
#CONFIG_LWIP_IP6_REASSEMBLY=y
#CONFIG_LWIP_PPP_SUPPORT=y
#CONFIG_LWIP_PPP_ENABLE_IPV6=y
CONFIG_APP_ROLLBACK_ENABLE=y
CONFIG_TASK_WDT_PANIC=y
CONFIG_FREERTOS_HZ=1000
```
