"--\n"
"-- File generated with SQLiteStudio v3.3.2 on Fr. Apr. 2 00:14:10 2021\n"
"--\n"
"-- Text encoding used: UTF-8\n"
"--\n"
"PRAGMA foreign_keys = off;\n"
"BEGIN TRANSACTION;\n"
"\n"
"-- Table: counters\n"
"CREATE TABLE counters (\n"
"    counter_id   INTEGER      PRIMARY KEY AUTOINCREMENT\n"
"                              NOT NULL,\n"
"    counter_name VARCHAR (20) NOT NULL\n"
"                              UNIQUE,\n"
"    unit_id      INTEGER      NOT NULL\n"
"                              REFERENCES units (unit_id),\n"
"    value        BIGINT       NOT NULL\n"
");\n"
"\n"
"INSERT INTO counters (\n"
"                         counter_id,\n"
"                         counter_name,\n"
"                         unit_id,\n"
"                         value\n"
"                     )\n"
"                     VALUES (\n"
"                         1,\n"
"                         'TOTAL_MOTOR_ON_TIME',\n"
"                         4,\n"
"                         0\n"
"                     );\n"
"\n"
"INSERT INTO counters (\n"
"                         counter_id,\n"
"                         counter_name,\n"
"                         unit_id,\n"
"                         value\n"
"                     )\n"
"                     VALUES (\n"
"                         2,\n"
"                         'DISC_USAGE_TIME',\n"
"                         4,\n"
"                         0\n"
"                     );\n"
"\n"
"INSERT INTO counters (\n"
"                         counter_id,\n"
"                         counter_name,\n"
"                         unit_id,\n"
"                         value\n"
"                     )\n"
"                     VALUES (\n"
"                         3,\n"
"                         'STANDBY_TIME',\n"
"                         2,\n"
"                         0\n"
"                     );\n"
"\n"
"INSERT INTO counters (\n"
"                         counter_id,\n"
"                         counter_name,\n"
"                         unit_id,\n"
"                         value\n"
"                     )\n"
"                     VALUES (\n"
"                         4,\n"
"                         'SYSTEM_ON_TIME',\n"
"                         2,\n"
"                         0\n"
"                     );\n"
"\n"
"INSERT INTO counters (\n"
"                         counter_id,\n"
"                         counter_name,\n"
"                         unit_id,\n"
"                         value\n"
"                     )\n"
"                     VALUES (\n"
"                         5,\n"
"                         'TOTAL_GRIND_SHOTS',\n"
"                         5,\n"
"                         0\n"
"                     );\n"
"\n"
"INSERT INTO counters (\n"
"                         counter_id,\n"
"                         counter_name,\n"
"                         unit_id,\n"
"                         value\n"
"                     )\n"
"                     VALUES (\n"
"                         6,\n"
"                         'TOTAL_GRIND_TIME',\n"
"                         4,\n"
"                         0\n"
"                     );\n"
"\n"
"\n"
"-- Table: error_types\n"
"CREATE TABLE error_types (\n"
"    error_type_id INTEGER       PRIMARY KEY AUTOINCREMENT\n"
"                                NOT NULL,\n"
"    error_name    VARCHAR (30)  NOT NULL\n"
"                                UNIQUE,\n"
"    description   VARCHAR (255) \n"
");\n"
"\n"
"INSERT INTO error_types (\n"
"                            error_type_id,\n"
"                            error_name,\n"
"                            description\n"
"                        )\n"
"                        VALUES (\n"
"                            1,\n"
"                            'GRINDER_CHAMBER_OPENED',\n"
"                            NULL\n"
"                        );\n"
"\n"
"INSERT INTO error_types (\n"
"                            error_type_id,\n"
"                            error_name,\n"
"                            description\n"
"                        )\n"
"                        VALUES (\n"
"                            2,\n"
"                            'HOPPER_DISMOUNTED',\n"
"                            NULL\n"
"                        );\n"
"\n"
"INSERT INTO error_types (\n"
"                            error_type_id,\n"
"                            error_name,\n"
"                            description\n"
"                        )\n"
"                        VALUES (\n"
"                            3,\n"
"                            'ESP_COM',\n"
"                            NULL\n"
"                        );\n"
"\n"
"INSERT INTO error_types (\n"
"                            error_type_id,\n"
"                            error_name,\n"
"                            description\n"
"                        )\n"
"                        VALUES (\n"
"                            4,\n"
"                            'MCU_COM',\n"
"                            NULL\n"
"                        );\n"
"\n"
"\n"
"-- Table: event_types\n"
"CREATE TABLE event_types (\n"
"    event_type_id INTEGER       PRIMARY KEY AUTOINCREMENT\n"
"                                NOT NULL,\n"
"    event_name    VARCHAR (20)  NOT NULL\n"
"                                UNIQUE,\n"
"    description   VARCHAR (255) \n"
");\n"
"\n"
"INSERT INTO event_types (\n"
"                            event_type_id,\n"
"                            event_name,\n"
"                            description\n"
"                        )\n"
"                        VALUES (\n"
"                            1,\n"
"                            'SYSTEM_RESTART',\n"
"                            'cold restart of grinder'\n"
"                        );\n"
"\n"
"INSERT INTO event_types (\n"
"                            event_type_id,\n"
"                            event_name,\n"
"                            description\n"
"                        )\n"
"                        VALUES (\n"
"                            2,\n"
"                            'ERROR_RAISE',\n"
"                            'event when a certain error is raised: timestamp and error type'\n"
"                        );\n"
"\n"
"INSERT INTO event_types (\n"
"                            event_type_id,\n"
"                            event_name,\n"
"                            description\n"
"                        )\n"
"                        VALUES (\n"
"                            3,\n"
"                            'ERROR_GONE',\n"
"                            'event when a certain error has gone: timestamp and error type'\n"
"                        );\n"
"\n"
"INSERT INTO event_types (\n"
"                            event_type_id,\n"
"                            event_name,\n"
"                            description\n"
"                        )\n"
"                        VALUES (\n"
"                            4,\n"
"                            'SW_UPDATE_PACKAGE',\n"
"                            'software update successfully completed, old package version, new package version'\n"
"                        );\n"
"\n"
"INSERT INTO event_types (\n"
"                            event_type_id,\n"
"                            event_name,\n"
"                            description\n"
"                        )\n"
"                        VALUES (\n"
"                            5,\n"
"                            'RECIPE_CHANGE',\n"
"                            NULL\n"
"                        );\n"
"\n"
"INSERT INTO event_types (\n"
"                            event_type_id,\n"
"                            event_name,\n"
"                            description\n"
"                        )\n"
"                        VALUES (\n"
"                            6,\n"
"                            'TECHNICIAN_LOGIN',\n"
"                            NULL\n"
"                        );\n"
"\n"
"INSERT INTO event_types (\n"
"                            event_type_id,\n"
"                            event_name,\n"
"                            description\n"
"                        )\n"
"                        VALUES (\n"
"                            7,\n"
"                            'OWNER_PIN_CHANGE',\n"
"                            NULL\n"
"                        );\n"
"\n"
"INSERT INTO event_types (\n"
"                            event_type_id,\n"
"                            event_name,\n"
"                            description\n"
"                        )\n"
"                        VALUES (\n"
"                            8,\n"
"                            'TECHNICIAN_PIN_CHANGE',\n"
"                            NULL\n"
"                        );\n"
"\n"
"INSERT INTO event_types (\n"
"                            event_type_id,\n"
"                            event_name,\n"
"                            description\n"
"                        )\n"
"                        VALUES (\n"
"                            9,\n"
"                            'OWNER_LOGOUT',\n"
"                            NULL\n"
"                        );\n"
"\n"
"INSERT INTO event_types (\n"
"                            event_type_id,\n"
"                            event_name,\n"
"                            description\n"
"                        )\n"
"                        VALUES (\n"
"                            10,\n"
"                            'OWNER_LOGIN',\n"
"                            NULL\n"
"                        );\n"
"\n"
"INSERT INTO event_types (\n"
"                            event_type_id,\n"
"                            event_name,\n"
"                            description\n"
"                        )\n"
"                        VALUES (\n"
"                            11,\n"
"                            'TECHNICIAN_LOGOUT',\n"
"                            NULL\n"
"                        );\n"
"\n"
"INSERT INTO event_types (\n"
"                            event_type_id,\n"
"                            event_name,\n"
"                            description\n"
"                        )\n"
"                        VALUES (\n"
"                            12,\n"
"                            'DISC_USAGE_TIME_RESET',\n"
"                            NULL\n"
"                        );\n"
"\n"
"INSERT INTO event_types (\n"
"                            event_type_id,\n"
"                            event_name,\n"
"                            description\n"
"                        )\n"
"                        VALUES (\n"
"                            13,\n"
"                            'DDD_CALIBRATE',\n"
"                            NULL\n"
"                        );\n"
"\n"
"INSERT INTO event_types (\n"
"                            event_type_id,\n"
"                            event_name,\n"
"                            description\n"
"                        )\n"
"                        VALUES (\n"
"                            14,\n"
"                            'RECIPE_DELETE',\n"
"                            NULL\n"
"                        );\n"
"\n"
"INSERT INTO event_types (\n"
"                            event_type_id,\n"
"                            event_name,\n"
"                            description\n"
"                        )\n"
"                        VALUES (\n"
"                            15,\n"
"                            'RECIPE_ADD',\n"
"                            NULL\n"
"                        );\n"
"\n"
"INSERT INTO event_types (\n"
"                            event_type_id,\n"
"                            event_name,\n"
"                            description\n"
"                        )\n"
"                        VALUES (\n"
"                            16,\n"
"                            'FACTORY_RESET',\n"
"                            NULL\n"
"                        );\n"
"\n"
"INSERT INTO event_types (\n"
"                            event_type_id,\n"
"                            event_name,\n"
"                            description\n"
"                        )\n"
"                        VALUES (\n"
"                            17,\n"
"                            'CHANGE_TEMP_WARNING',\n"
"                            NULL\n"
"                        );\n"
"\n"
"INSERT INTO event_types (\n"
"                            event_type_id,\n"
"                            event_name,\n"
"                            description\n"
"                        )\n"
"                        VALUES (\n"
"                            18,\n"
"                            'CHANGE_SHOW_TEMP',\n"
"                            NULL\n"
"                        );\n"
"\n"
"INSERT INTO event_types (\n"
"                            event_type_id,\n"
"                            event_name,\n"
"                            description\n"
"                        )\n"
"                        VALUES (\n"
"                            19,\n"
"                            'CHANGE_BRIGHTNESS',\n"
"                            NULL\n"
"                        );\n"
"\n"
"INSERT INTO event_types (\n"
"                            event_type_id,\n"
"                            event_name,\n"
"                            description\n"
"                        )\n"
"                        VALUES (\n"
"                            20,\n"
"                            'CHANGE_STANDBY_TIME',\n"
"                            NULL\n"
"                        );\n"
"\n"
"INSERT INTO event_types (\n"
"                            event_type_id,\n"
"                            event_name,\n"
"                            description\n"
"                        )\n"
"                        VALUES (\n"
"                            21,\n"
"                            'CHANGE_SHOW_SPOTLIGHT',\n"
"                            NULL\n"
"                        );\n"
"\n"
"INSERT INTO event_types (\n"
"                            event_type_id,\n"
"                            event_name,\n"
"                            description\n"
"                        )\n"
"                        VALUES (\n"
"                            22,\n"
"                            'CHANGE_SHOW_DDD',\n"
"                            NULL\n"
"                        );\n"
"\n"
"INSERT INTO event_types (\n"
"                            event_type_id,\n"
"                            event_name,\n"
"                            description\n"
"                        )\n"
"                        VALUES (\n"
"                            23,\n"
"                            'CHANGE_SHOW_LIBRARY_MODE',\n"
"                            NULL\n"
"                        );\n"
"\n"
"INSERT INTO event_types (\n"
"                            event_type_id,\n"
"                            event_name,\n"
"                            description\n"
"                        )\n"
"                        VALUES (\n"
"                            24,\n"
"                            'CHANGE_SHOW_TIME_MODE',\n"
"                            NULL\n"
"                        );\n"
"\n"
"INSERT INTO event_types (\n"
"                            event_type_id,\n"
"                            event_name,\n"
"                            description\n"
"                        )\n"
"                        VALUES (\n"
"                            25,\n"
"                            'CHANGE_GRINDER_NAME',\n"
"                            NULL\n"
"                        );\n"
"\n"
"INSERT INTO event_types (\n"
"                            event_type_id,\n"
"                            event_name,\n"
"                            description\n"
"                        )\n"
"                        VALUES (\n"
"                            26,\n"
"                            'CHANGE_TEMP_UNIT',\n"
"                            NULL\n"
"                        );\n"
"\n"
"INSERT INTO event_types (\n"
"                            event_type_id,\n"
"                            event_name,\n"
"                            description\n"
"                        )\n"
"                        VALUES (\n"
"                            27,\n"
"                            'CHANGE_TIME',\n"
"                            NULL\n"
"                        );\n"
"\n"
"INSERT INTO event_types (\n"
"                            event_type_id,\n"
"                            event_name,\n"
"                            description\n"
"                        )\n"
"                        VALUES (\n"
"                            28,\n"
"                            'CHANGE_DATE',\n"
"                            NULL\n"
"                        );\n"
"\n"
"INSERT INTO event_types (\n"
"                            event_type_id,\n"
"                            event_name,\n"
"                            description\n"
"                        )\n"
"                        VALUES (\n"
"                            29,\n"
"                            'CHANGE_WIFI_SETTINGS',\n"
"                            NULL\n"
"                        );\n"
"\n"
"INSERT INTO event_types (\n"
"                            event_type_id,\n"
"                            event_name,\n"
"                            description\n"
"                        )\n"
"                        VALUES (\n"
"                            30,\n"
"                            'CHANGE_TEMP_THRESHOLD',\n"
"                            NULL\n"
"                        );\n"
"\n"
"INSERT INTO event_types (\n"
"                            event_type_id,\n"
"                            event_name,\n"
"                            description\n"
"                        )\n"
"                        VALUES (\n"
"                            31,\n"
"                            'CHANGE_WIFI_ON',\n"
"                            NULL\n"
"                        );\n"
"\n"
"INSERT INTO event_types (\n"
"                            event_type_id,\n"
"                            event_name,\n"
"                            description\n"
"                        )\n"
"                        VALUES (\n"
"                            32,\n"
"                            'CHANGE_AUTO_LOGOUT',\n"
"                            NULL\n"
"                        );\n"
"\n"
"INSERT INTO event_types (\n"
"                            event_type_id,\n"
"                            event_name,\n"
"                            description\n"
"                        )\n"
"                        VALUES (\n"
"                            33,\n"
"                            'CHANGE_START_OF_WEEK',\n"
"                            NULL\n"
"                        );\n"
"\n"
"INSERT INTO event_types (\n"
"                            event_type_id,\n"
"                            event_name,\n"
"                            description\n"
"                        )\n"
"                        VALUES (\n"
"                            34,\n"
"                            'SW_UPDATE_ESP',\n"
"                            NULL\n"
"                        );\n"
"\n"
"INSERT INTO event_types (\n"
"                            event_type_id,\n"
"                            event_name,\n"
"                            description\n"
"                        )\n"
"                        VALUES (\n"
"                            35,\n"
"                            'SW_UPDATE_MCU',\n"
"                            NULL\n"
"                        );\n"
"\n"
"\n"
"-- Table: events\n"
"CREATE TABLE events (\n"
"    event_id      INTEGER      PRIMARY KEY AUTOINCREMENT\n"
"                               NOT NULL,\n"
"    timestamp     DATETIME     NOT NULL,\n"
"    event_type_id INTEGER      REFERENCES event_types (event_type_id) \n"
"                               NOT NULL,\n"
"    recipe_id     INTEGER      REFERENCES recipes (recipe_id),\n"
"    error_type_id INTEGER      REFERENCES error_types (error_type_id),\n"
"    context       VARCHAR (50) \n"
");\n"
"\n"
"\n"
"-- Table: grinds\n"
"CREATE TABLE grinds (\n"
"    grind_id          INTEGER  PRIMARY KEY AUTOINCREMENT\n"
"                               NOT NULL,\n"
"    recipe_id         INTEGER  REFERENCES recipes\n"
"                               NOT NULL,\n"
"    timestamp         DATETIME NOT NULL,\n"
"    grind_time_100ths BIGINT   NOT NULL\n"
");\n"
"\n"
"\n"
"-- Table: recipe_modes\n"
"CREATE TABLE recipe_modes (\n"
"    recipe_mode_id   INTEGER      PRIMARY KEY\n"
"                                  NOT NULL,\n"
"    recipe_mode_name VARCHAR (20) NOT NULL\n"
"                                  UNIQUE,\n"
"    description      VARCHAR (30) \n"
");\n"
"\n"
"INSERT INTO recipe_modes (\n"
"                             recipe_mode_id,\n"
"                             recipe_mode_name,\n"
"                             description\n"
"                         )\n"
"                         VALUES (\n"
"                             0,\n"
"                             'CLASSIC',\n"
"                             'CLASSIC MODE'\n"
"                         );\n"
"\n"
"INSERT INTO recipe_modes (\n"
"                             recipe_mode_id,\n"
"                             recipe_mode_name,\n"
"                             description\n"
"                         )\n"
"                         VALUES (\n"
"                             1,\n"
"                             'TIME',\n"
"                             'TIME MODE'\n"
"                         );\n"
"\n"
"INSERT INTO recipe_modes (\n"
"                             recipe_mode_id,\n"
"                             recipe_mode_name,\n"
"                             description\n"
"                         )\n"
"                         VALUES (\n"
"                             2,\n"
"                             'LIBRARY',\n"
"                             'LIBRARY MODE'\n"
"                         );\n"
"\n"
"\n"
"-- Table: recipes\n"
"CREATE TABLE recipes (\n"
"    recipe_id          INTEGER      NOT NULL\n"
"                                    PRIMARY KEY AUTOINCREMENT,\n"
"    recipe_uuid        VARCHAR (37) NOT NULL\n"
"                                    UNIQUE,\n"
"    recipe_name        VARCHAR (30) NOT NULL,\n"
"    recipe_mode_id     INTEGER (1)  REFERENCES recipe_modes (recipe_mode_id) \n"
"                                    NOT NULL,\n"
"    porta_filter_index INTEGER (1) \n"
");\n"
"\n"
"INSERT INTO recipes (\n"
"                        recipe_id,\n"
"                        recipe_uuid,\n"
"                        recipe_name,\n"
"                        recipe_mode_id,\n"
"                        porta_filter_index\n"
"                    )\n"
"                    VALUES (\n"
"                        1,\n"
"                        '52659fdc-7f2e-4ec1-a23c-d82a0d9fbd1f',\n"
"                        'Classic',\n"
"                        0,\n"
"                        NULL\n"
"                    );\n"
"\n"
"INSERT INTO recipes (\n"
"                        recipe_id,\n"
"                        recipe_uuid,\n"
"                        recipe_name,\n"
"                        recipe_mode_id,\n"
"                        porta_filter_index\n"
"                    )\n"
"                    VALUES (\n"
"                        2,\n"
"                        '1efe7671-b365-4a3c-8cbb-90f0cf6a7baf',\n"
"                        'Recipe 1',\n"
"                        1,\n"
"                        0\n"
"                    );\n"
"\n"
"INSERT INTO recipes (\n"
"                        recipe_id,\n"
"                        recipe_uuid,\n"
"                        recipe_name,\n"
"                        recipe_mode_id,\n"
"                        porta_filter_index\n"
"                    )\n"
"                    VALUES (\n"
"                        3,\n"
"                        'a58a9991-49c8-4efa-afb8-3b75f85d4f1f',\n"
"                        'Recipe 2',\n"
"                        1,\n"
"                        1\n"
"                    );\n"
"\n"
"INSERT INTO recipes (\n"
"                        recipe_id,\n"
"                        recipe_uuid,\n"
"                        recipe_name,\n"
"                        recipe_mode_id,\n"
"                        porta_filter_index\n"
"                    )\n"
"                    VALUES (\n"
"                        4,\n"
"                        'd99006ac-a8f4-415a-96f0-7067373fd8d8',\n"
"                        'Recipe 3',\n"
"                        1,\n"
"                        2\n"
"                    );\n"
"\n"
"INSERT INTO recipes (\n"
"                        recipe_id,\n"
"                        recipe_uuid,\n"
"                        recipe_name,\n"
"                        recipe_mode_id,\n"
"                        porta_filter_index\n"
"                    )\n"
"                    VALUES (\n"
"                        5,\n"
"                        'd03abbec-1b89-4661-af39-cfaf1aab8e4d',\n"
"                        'Recipe 4',\n"
"                        1,\n"
"                        NULL\n"
"                    );\n"
"\n"
"INSERT INTO recipes (\n"
"                        recipe_id,\n"
"                        recipe_uuid,\n"
"                        recipe_name,\n"
"                        recipe_mode_id,\n"
"                        porta_filter_index\n"
"                    )\n"
"                    VALUES (\n"
"                        6,\n"
"                        'd812779f-431b-44c1-ac2f-82ca9471ea40',\n"
"                        'Recipe 5',\n"
"                        1,\n"
"                        NULL\n"
"                    );\n"
"\n"
"INSERT INTO recipes (\n"
"                        recipe_id,\n"
"                        recipe_uuid,\n"
"                        recipe_name,\n"
"                        recipe_mode_id,\n"
"                        porta_filter_index\n"
"                    )\n"
"                    VALUES (\n"
"                        7,\n"
"                        '6db9c354-eb34-4e5d-8220-a152cb8c5e0c',\n"
"                        'Recipe 6',\n"
"                        1,\n"
"                        NULL\n"
"                    );\n"
"\n"
"INSERT INTO recipes (\n"
"                        recipe_id,\n"
"                        recipe_uuid,\n"
"                        recipe_name,\n"
"                        recipe_mode_id,\n"
"                        porta_filter_index\n"
"                    )\n"
"                    VALUES (\n"
"                        8,\n"
"                        '32fac243-8ed7-47ba-bf57-a9cba8f0e3cf',\n"
"                        'El Puente',\n"
"                        2,\n"
"                        NULL\n"
"                    );\n"
"\n"
"INSERT INTO recipes (\n"
"                        recipe_id,\n"
"                        recipe_uuid,\n"
"                        recipe_name,\n"
"                        recipe_mode_id,\n"
"                        porta_filter_index\n"
"                    )\n"
"                    VALUES (\n"
"                        9,\n"
"                        '4e379882-c2f0-4b36-9cd1-cdc67d768b1b',\n"
"                        'Burundi Bwayi',\n"
"                        2,\n"
"                        NULL\n"
"                    );\n"
"\n"
"INSERT INTO recipes (\n"
"                        recipe_id,\n"
"                        recipe_uuid,\n"
"                        recipe_name,\n"
"                        recipe_mode_id,\n"
"                        porta_filter_index\n"
"                    )\n"
"                    VALUES (\n"
"                        10,\n"
"                        '816dba71-dcbb-46fc-878b-f14fd826d2bc',\n"
"                        'Mischgold',\n"
"                        2,\n"
"                        NULL\n"
"                    );\n"
"\n"
"INSERT INTO recipes (\n"
"                        recipe_id,\n"
"                        recipe_uuid,\n"
"                        recipe_name,\n"
"                        recipe_mode_id,\n"
"                        porta_filter_index\n"
"                    )\n"
"                    VALUES (\n"
"                        11,\n"
"                        'b57afa23-b02e-4d38-99a1-63a2cc109c51',\n"
"                        'La Dalia',\n"
"                        2,\n"
"                        NULL\n"
"                    );\n"
"\n"
"\n"
"-- Table: settings\n"
"CREATE TABLE settings (\n"
"    [key] VARCHAR (30) PRIMARY KEY\n"
"                       UNIQUE\n"
"                       NOT NULL,\n"
"    value VARCHAR (30) \n"
");\n"
"\n"
"INSERT INTO settings (\n"
"                         [key],\n"
"                         value\n"
"                     )\n"
"                     VALUES (\n"
"                         'Version',\n"
"                         '2'\n"
"                     );\n"
"\n"
"\n"
"-- Table: units\n"
"CREATE TABLE units (\n"
"    unit_id   INTEGER      PRIMARY KEY AUTOINCREMENT\n"
"                           NOT NULL,\n"
"    unit_name VARCHAR (20) NOT NULL\n"
"                           UNIQUE,\n"
"    label     VARCHAR (20) NOT NULL\n"
");\n"
"\n"
"INSERT INTO units (\n"
"                      unit_id,\n"
"                      unit_name,\n"
"                      label\n"
"                  )\n"
"                  VALUES (\n"
"                      1,\n"
"                      'MILLISECONDS',\n"
"                      '[ms]'\n"
"                  );\n"
"\n"
"INSERT INTO units (\n"
"                      unit_id,\n"
"                      unit_name,\n"
"                      label\n"
"                  )\n"
"                  VALUES (\n"
"                      2,\n"
"                      'SECONDS',\n"
"                      '[s]'\n"
"                  );\n"
"\n"
"INSERT INTO units (\n"
"                      unit_id,\n"
"                      unit_name,\n"
"                      label\n"
"                  )\n"
"                  VALUES (\n"
"                      3,\n"
"                      '10TH_SECSONDS',\n"
"                      '[1/10s]'\n"
"                  );\n"
"\n"
"INSERT INTO units (\n"
"                      unit_id,\n"
"                      unit_name,\n"
"                      label\n"
"                  )\n"
"                  VALUES (\n"
"                      4,\n"
"                      '100TH_SECONDS',\n"
"                      '[1/100s]'\n"
"                  );\n"
"\n"
"INSERT INTO units (\n"
"                      unit_id,\n"
"                      unit_name,\n"
"                      label\n"
"                  )\n"
"                  VALUES (\n"
"                      5,\n"
"                      'AMOUNT',\n"
"                      '[x]'\n"
"                  );\n"
"\n"
"\n"
"COMMIT TRANSACTION;\n"
"PRAGMA foreign_keys = on;\n"
