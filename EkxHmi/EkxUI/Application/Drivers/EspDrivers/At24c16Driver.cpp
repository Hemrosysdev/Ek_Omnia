///////////////////////////////////////////////////////////////////////////////
///
/// @file At24c16.cpp
///
/// @brief main application entry point of At24c16.
///
/// @author Ultratronik GmbH
///         Dornierstr. 9
///         D-82205 Gilching
///         Germany
///         http://www.ultratronik.de
///
/// @author written by Florian Sonntag, Forschung & Entwicklung, gesser@ultratronik.de
///
/// @date 31.03.2021
///
/// @copyright Copyright 2021 by Hemro International AG
///            Hemro International AG
///            Länggenstrasse 34
///            CH 8184 Bachenbülach
///            Switzerland
///            Homepage: www.hemrogroup.com
///
///////////////////////////////////////////////////////////////////////////////

#include "At24c16Driver.h"

#include <QDebug>

///////////////////////////////////////////////////////////////////////////////
//
//
///////////////////////////////////////////////////////////////////////////////

At24c16Driver::At24c16Driver( const EkxProtocol::DriverId u8DriverId )
    : EspDeviceDriver( u8DriverId )
{
}

///////////////////////////////////////////////////////////////////////////////
//
//
///////////////////////////////////////////////////////////////////////////////

At24c16Driver::~At24c16Driver()
{
}

///////////////////////////////////////////////////////////////////////////////
//
//
///////////////////////////////////////////////////////////////////////////////

const QString & At24c16Driver::productId() const
{
    return m_strProductId;
}

///////////////////////////////////////////////////////////////////////////////
//
//
///////////////////////////////////////////////////////////////////////////////

void At24c16Driver::setProductId( const QString & strProductId )
{
    if ( strProductId != m_strProductId )
    {
        m_strProductId = strProductId;
        emit productIdChanged();
    }
}

///////////////////////////////////////////////////////////////////////////////
//
//
///////////////////////////////////////////////////////////////////////////////

const QString & At24c16Driver::serialNumber() const
{
    return m_strSerialNumber;
}

///////////////////////////////////////////////////////////////////////////////
//
//
///////////////////////////////////////////////////////////////////////////////

void At24c16Driver::setSerialNumber( const QString & strSerialNumber )
{
    if ( strSerialNumber != m_strSerialNumber )
    {
        m_strSerialNumber = strSerialNumber;
        emit serialNumberChanged();
    }
}

///////////////////////////////////////////////////////////////////////////////
//
//
///////////////////////////////////////////////////////////////////////////////

bool At24c16Driver::isValid() const
{
    return m_bValid;
}

///////////////////////////////////////////////////////////////////////////////
//
//
///////////////////////////////////////////////////////////////////////////////

void At24c16Driver::processMessageFrame( const EkxProtocol::MessageFrame & frame )
{
    const EkxProtocol::Payload::EepromStatus * pPayload = dynamic_cast<const EkxProtocol::Payload::EepromStatus *>( frame.payloadRef().value() );

    if ( pPayload )
    {
        setValid( pPayload->valid().value() );
        setProductId( pPayload->productNo().value().c_str() );
        setSerialNumber( pPayload->serialNo().value().c_str() );

        replyAck( frame.driverId().value(),
                  frame.msgCounter().value(),
                  frame.repeatCounter().value() );
    }
    else
    {
        replyNack( frame.driverId().value(),
                   frame.msgCounter().value(),
                   frame.repeatCounter().value(),
                   EkxProtocol::Payload::Nack::NackReason::PayloadBroken );
    }
}

///////////////////////////////////////////////////////////////////////////////
//
//
///////////////////////////////////////////////////////////////////////////////

void At24c16Driver::processAlive( const bool bAlive )
{
    if ( !bAlive )
    {
        setValid( false );
    }
}

///////////////////////////////////////////////////////////////////////////////
//
//
///////////////////////////////////////////////////////////////////////////////

void At24c16Driver::setValid( const bool bValid )
{
    if ( bValid != m_bValid )
    {
        m_bValid = bValid;
        emit validChanged();
    }
}

///////////////////////////////////////////////////////////////////////////////
//
//
///////////////////////////////////////////////////////////////////////////////

